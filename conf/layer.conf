## conf/layer.conf
```bitbake
# We have a conf and classes directory, add to BBPATH
BBPATH .= ":${LAYERDIR}"

# We have recipes-* directories, add to BBFILES
BBFILES += "${LAYERDIR}/recipes-*/*/*.bb \
            ${LAYERDIR}/recipes-*/*/*.bbappend"

BBFILE_COLLECTIONS += "meta-dual-sdmmc"
BBFILE_PATTERN_meta-dual-sdmmc = "^${LAYERDIR}/"
BBFILE_PRIORITY_meta-dual-sdmmc = "6"

LAYERDEPENDS_meta-dual-sdmmc = "core"
LAYERSERIES_COMPAT_meta-dual-sdmmc = "kirkstone"
```
